## CMakeLists.txt
```
if(CONFIG_MODALITY_PROBE_TRACING)
  set(MODALITY_PROBE_TRACE_DIR ${ZEPHYR_CURRENT_MODULE_DIR})
  find_package(ModalityProbe REQUIRED)
  zephyr_library()
  zephyr_include_directories(${MODALITY_PROBE_TRACE_DIR}/source/include)
  zephyr_library_sources(${MODALITY_PROBE_TRACE_DIR}/source/modality_probe_trace.c)
  add_subdirectory_ifdef(CONFIG_MODALITY_PROBE_IO_TRANSPORT_SOCKET ${MODALITY_PROBE_TRACE_DIR}/source/io/socket)
  zephyr_library_link_libraries(ModalityProbe::LibModalityProbe)
  zephyr_include_directories(${MODALITY_PROBE_INCLUDE_DIRS})
endif()
```

## Kconfig
```
if TRACING_EXTERNAL

menu "Modality Probe Tracing"

config MODALITY_PROBE_TRACING
    bool "Modality probe tracing support"
    default y
    select THREAD_NAME
    select INIT_STACKS
    select THREAD_MONITOR
    help
      Enable Modality probe tracing support.
      When enabled, each thread will be allocated a Modality probe (unless excluded via `trace_exclude_thread(thread-name)`).

if MODALITY_PROBE_TRACING

config MODALITY_PROBE_DO_STARTUP_INITIALIZATION
    bool "Startup initialization"
    default y
    help
      Enable tracing initialization on startup. Initialization runs at the PRE_KERNEL_1 level, with priority of 0.
      By default the following threads are excluded from tracing:
        - "idle 00"
        - "logging"
        - "thread_analyzer"
        - "net_mgmt"
        - "tcp_work"
        - "sysworkq"
        - "main" (if MODALITY_PROBE_EXCLUDE_MAIN_THREAD is not enabled)
        - TRACE_IO_THEAD_NAME (if MODALITY_PROBE_INCLUDE_IO_THREAD is enabled)

config MODALITY_PROBE_EXCLUDE_MAIN_THREAD
    bool "Exlude the main thread from tracing" if MODALITY_PROBE_DO_STARTUP_INITIALIZATION
    default y
    help
      Exclude the main thread from tracing.
      Only used if `MODALITY_PROBE_DO_STARTUP_INITIALIZATION` is enabled.

config MODALITY_PROBE_USE_PRINTK
    bool "Output debug messages with printk"
    default y
    select PRINTK
    help
      The tracing implementation outputs debugging messages by calling the `TRACE_DEBUG_PRINTF()` macro.
      When enabled, the `TRACE_DEBUG_PRINTF()` macro will call `printk()`.

config MODALITY_PROBE_INCLUDE_CRITICAL_SECTION_WRAPPED_API_MACROS
    bool "Include critical-section-wrapped Modality probe API macros"
    default y
    help
      When enabled, all of the Modality probe API macros normally defined in `modality/probe.h`
      will get redefined to use a critical section.
      This is useful when using the probes at the thread level for application events where the
      threads are preemptible.

config MODALITY_PROBE_USE_TRACE_ASSERT
    bool "Enable trace assertions"
    default y
    help
      Enable the internal tracing asserts.
      It is recommened to have this enabled during development and integration for error checking.
      When an assert is triggered, `trace_disable()` is called and the error message can be
      retrieved by calling `trace_get_error()`.

config MODALITY_PROBE_USE_STATIC_ALLOCATION
    bool "Static allocation mode"
    help
      When enabled, Modality probe and tracing resources are allocated statically.
      Otherwise resources are allocated using `TRACE_MALLOC()`, and free'd using `TRACE_FREE()`.

config MODALITY_PROBE_STATIC_STORAGE_SIZE
	int "Static probe storage memory pool size" if MODALITY_PROBE_USE_STATIC_ALLOCATION
	depends on MODALITY_PROBE_USE_STATIC_ALLOCATION
    range 64 65535
    default 2048
	help
      The size, in bytes, of the global probe log storage buffer.
      Only used when `MODALITY_PROBE_USE_STATIC_ALLOCATION` is enabled.

config MODALITY_PROBE_THREAD_PROBE_SIZE
	int "Probe log buffer size"
    default 1024
	help
      The size, in bytes, of each probe's log storage buffer.
      When `MODALITY_PROBE_USE_STATIC_ALLOCATION` is enabled, probe buffers are allocated from
      a single global byte array, see `MODALITY_PROBE_STATIC_STORAGE_SIZE`.

config MODALITY_PROBE_MAX_PROBES
	int "Size of the probe registry"
    default 8
	help
      The maximun number of Modality probes available to the system.
      Unless excluded with `trace_exclude_thread()`, each thread will be allocated a Modality probe.

config MODALITY_PROBE_MAX_EXCLUDED_THREADS
	int "Size of the excluded thread registry"
    default 16
	help
      The maximun number of entries that can be stored in the task exclude list for thread-level initialization filtering.
      See `trace_exclude_thread()`.

config MODALITY_PROBE_INCLUDE_IO_THREAD
    bool "Include IO thread"
    default y
    help
      When enabled, an internal thread will be created to manage the IO for the probes.
      The IO thread is responsible for getting reports and mutator announcements sent out
      to a Modality collector (or file for later processing) via `TRACE_IO_WRITE()`, and
      optionally getting control plane messages in via `TRACE_IO_READ()`.
      IO transport initialization is optionally provided via `TRACE_IO_INIT()`.

if MODALITY_PROBE_INCLUDE_IO_THREAD

    config MODALITY_PROBE_IO_THREAD_NAME
        string "IO thread name"
        default "ModalityProbeIo"
        help
          The IO thread name.

    config MODALITY_PROBE_IO_THREAD_STACK_SIZE
        int "IO thread stack size"
        range 512 65535
        default 2048
        help
          The stack size, in bytes, of the internal IO thread.

    config MODALITY_PROBE_IO_THREAD_PRIORITY
        int "IO thread priority"
        range -32 32
        default 8
        help
          The priority of the internal IO thread.

    config MODALITY_PROBE_IO_THREAD_BUFFER_SIZE
        int "IO thread data buffer size"
        range 64 65535
        default 512
        help
          The size, in bytes, of the internal buffer used by the IO thread for
          reports, mutator announcements, and control plane buffering.

    config MODALITY_PROBE_IO_THREAD_STARTUP_DELAY_MS
        int "IO thread startup milliseconds delay"
        range 0 1000000000
        default 20
        help
          The number of milliseconds used to `k_msleep()` in the IO thread before it begins its loop.

    config MODALITY_PROBE_IO_THREAD_DELAY_MS
        int "IO thread loop milliseconds delay"
        range 0 1000000000
        default 50
        help
           The number of milliseconds used to `k_msleep()` in the IO thread loop.
           This effectively defines the IO polling and reporting interval.

    config MODALITY_PROBE_IO_THREAD_ITERS_PER_MUTATOR_ANNOUNCEMENT
        int "IO thread loop iterations per mutator announcements"
        range 1 1000000000
        default 20
        help
          The number of iterations in the IO thread before reporting mutator announcements.
          Mutator announcements only need to be reported once, but doing it occasionally
          is recommended if the IO transport is lossy.

    config MODALITY_PROBE_USE_CONTROL_PLANE_MESSAGE_QUEUE
        bool "Allocate control plane message queues"
        depends on !MODALITY_PROBE_USE_STATIC_ALLOCATION
        help
          When enabled, threads may opt-in to control plane message handling by
          calling `trace_alloc_control_plane_message_queue()`.
          Control plane messages may be processed by calling `trace_process_control_plane_message()`.

if MODALITY_PROBE_USE_CONTROL_PLANE_MESSAGE_QUEUE
    config MODALITY_PROBE_CONTROL_PLANE_MESSAGE_QUEUE_SIZE
        int "Capacity of the control plane message queues"
        range 1 32
        default 4
        help
          The capacity of control plane message queues.
          Each message can buffer up to `MODALITY_PROBE_IO_THREAD_BUFFER_SIZE` bytes.
endif # MODALITY_PROBE_USE_CONTROL_PLANE_MESSAGE_QUEUE

endif # MODALITY_PROBE_INCLUDE_IO_THREAD

menu "IO Transport Configuration"
depends on MODALITY_PROBE_INCLUDE_IO_THREAD
choice MODALITY_PROBE_IO_TRANSPORT
	prompt "IO transport selection"
	default MODALITY_PROBE_IO_TRANSPORT_SOCKET
	help
      Which IO transport implementation to use.

config MODALITY_PROBE_IO_TRANSPORT_SOCKET
    bool "Use sockets for IO"
    select NETWORKING
    select NET_SOCKETS
    select NET_IPV4
    select NET_TCP
    help
      Use Zephyr sockets for IO.
endchoice

if MODALITY_PROBE_IO_TRANSPORT_SOCKET
rsource "source/io/socket/Kconfig"
endif # MODALITY_PROBE_IO_TRANSPORT_SOCKET

endmenu # "IO Transport Configuration"

endif # MODALITY_PROBE_TRACING

endmenu # "Modality Probe Tracing"

endif # TRACING_EXTERNAL
```

## west.yml
```
manifest:
  remotes:
    - name:  zephyrproject-rtos
      url-base: https://github.com/zephyrproject-rtos
  projects:
    - name: zephyr
      remote: zephyrproject-rtos
      revision: v2.5.0
      import: true
  self:
    path: modapp
    
```

## prj.conf
```kconfig
# General config
CONFIG_NEWLIB_LIBC=y
CONFIG_MAIN_STACK_SIZE=1200

# Networking config
CONFIG_NETWORKING=y
CONFIG_NET_IPV4=y
CONFIG_NET_IPV6=n
CONFIG_NET_TCP=y
CONFIG_NET_SOCKETS=y
CONFIG_NET_SOCKETS_POSIX_NAMES=y

# Network driver config
CONFIG_TEST_RANDOM_GENERATOR=y

# Network address config
CONFIG_NET_CONFIG_SETTINGS=y
CONFIG_NET_CONFIG_NEED_IPV4=y
CONFIG_NET_CONFIG_MY_IPV4_ADDR="192.0.2.1"
CONFIG_NET_CONFIG_PEER_IPV4_ADDR="192.0.2.2"

# Overlay for experimental TCP as qemu_x86 with E1000
# CONFIG_PCIE=y
# CONFIG_ETH_E1000=y
# CONFIG_NET_SLIP_TAP=y

CONFIG_ETH_STELLARIS=y

CONFIG_NET_L2_ETHERNET=y
CONFIG_NET_QEMU_ETHERNET=y

CONFIG_THREAD_CUSTOM_DATA=y

CONFIG_HW_STACK_PROTECTION=y
CONFIG_STACK_CANARIES=y
```

## src/main.c
```c
#include <assert.h>
#include <modality/mutator.h>
#include <modality/probe.h>
#include <stdio.h>
#include <stdlib.h>
#include <zephyr.h>

#include "generated/modality_component_definitions.h"
#include "generated_mutators/delay_mutator.h"
#include "modality_comms.h"

#define STACK_SIZE 2048
#define PRODUCER_PRI -1
#define CONSUMER_PRI -1

uint8_t g_main_probe_buffer[1024];
uint8_t g_producer_probe_buffer[1024];
uint8_t g_consumer_probe_buffer[1024];

static void producer_run(void);
K_THREAD_DEFINE(producer_thread_id, STACK_SIZE, producer_run, NULL, NULL, NULL,
                PRODUCER_PRI, 0, -1);
K_MSGQ_DEFINE(producer_control_msgq, sizeof(void *), 2, sizeof(void *));

static void consumer_run(void);
K_THREAD_DEFINE(consumer_thread_id, STACK_SIZE, consumer_run, NULL, NULL, NULL,
                CONSUMER_PRI, 0, -1);
K_MSGQ_DEFINE(consumer_control_msgq, sizeof(void *), 2, sizeof(void *));

K_FIFO_DEFINE(number_fifo);

void main(void) {
  int err;
  modality_probe *probe = MODALITY_PROBE_NULL_INITIALIZER;
  err = MODALITY_PROBE_INIT(
      &g_main_probe_buffer[0], sizeof(g_main_probe_buffer), MAIN,
      MODALITY_PROBE_TIME_RESOLUTION_UNSPECIFIED,
      MODALITY_PROBE_WALL_CLOCK_ID_LOCAL_ONLY, NULL, NULL, &probe);
  assert(err == MODALITY_PROBE_ERROR_OK);

  err = register_probe(probe, NULL);
  assert(err == PROBE_REGISTRY_OK);

  MODALITY_PROBE_RECORD(probe, STARTUP_BEGIN);

  start_modality_comms();

  k_thread_start(producer_thread_id);
  k_thread_start(consumer_thread_id);

  MODALITY_PROBE_RECORD(probe, STARTUP_DONE);
}

static void producer_run(void) {
  int err;
  modality_probe *probe = MODALITY_PROBE_NULL_INITIALIZER;
  err = MODALITY_PROBE_INIT(
      &g_producer_probe_buffer[0], sizeof(g_producer_probe_buffer), PRODUCER,
      MODALITY_PROBE_TIME_RESOLUTION_UNSPECIFIED,
      MODALITY_PROBE_WALL_CLOCK_ID_LOCAL_ONLY, NULL, NULL, &probe);
  assert(err == MODALITY_PROBE_ERROR_OK);

  uint32_t delay_ms = 200;
  MODALITY_MUTATOR(probe, DELAY_MUTATOR, delay_ms,
                   MODALITY_PARAM_DEF(U32, 200, NOMINAL(0, 400), SAFETY(0, 400),
                                      HARD(0, 400)),
                   &delay_ms, sizeof(delay_ms));

  err = register_probe(probe, &producer_control_msgq);
  assert(err == PROBE_REGISTRY_OK);

  MODALITY_PROBE_RECORD(probe, PRODUCER_STARTED);

  uint32_t counter = 0;
  while (1) {
    poll_control_plane_messages();
    counter++;

    printf("Producer sending %i\n", counter);
    k_fifo_put(&number_fifo, &counter);

    MODALITY_PROBE_RECORD_W_U32(probe, PRODUCER_SENT, counter);

    k_sleep(K_MSEC(delay_ms));
  }
}

static void consumer_run(void) {
  int err;

  modality_probe *probe = MODALITY_PROBE_NULL_INITIALIZER;
  err = MODALITY_PROBE_INIT(
      &g_consumer_probe_buffer[0], sizeof(g_consumer_probe_buffer), CONSUMER,
      MODALITY_PROBE_TIME_RESOLUTION_UNSPECIFIED,
      MODALITY_PROBE_WALL_CLOCK_ID_LOCAL_ONLY, NULL, NULL, &probe);
  assert(err == MODALITY_PROBE_ERROR_OK);

  err = register_probe(probe, &consumer_control_msgq);
  assert(err == PROBE_REGISTRY_OK);

  MODALITY_PROBE_RECORD(probe, CONSUMER_STARTED);

  while (1) {
    poll_control_plane_messages();
    uint32_t *num = k_fifo_get(&number_fifo, K_FOREVER);
    printf("Consumer got %i\n", *num);

    MODALITY_PROBE_RECORD_W_U32(probe, CONSUMER_RECEIVED, *num);
  }
}
```

## include/modality_comms.h
```c
#pragma once
#include <zephyr.h>
#include <modality/probe.h>

/** Start the control thread and the scheduled reporting task. */
int start_modality_comms(void);

#define PROBE_REGISTRY_OK 0
#define PROBE_REGISTRY_FULL -1

/** After a probe is initialized, register it with the control thread
    and periodic reporting task, and for usage with all trace-level
    instrumentation from this thread. This must be called from the
    thread the probe will be used from.

    - probe: The already-allocated probe for the current thread.

    - control_msgq: The message queue to use for distributing control
      messages to each thread. It should be allocated like this:

         K_MSGQ_DEFINE(my_control_msgq, sizeof(void *), 2, sizeof(void *));

      All you need to do is allocate it; everything else is handled
      automatically.
    */
int8_t register_probe(modality_probe *probe, struct k_msgq *control_msgq);

/** Handle any pending control messages for the calling thread.  Send
    mutator announcements if necessary. */
void poll_control_plane_messages();

/** Get the probe that's registered with the current thread, if there
    is one. NULL if there isn't. */
modality_probe *current_thread_probe();
```

## include/modality_tracing.h
```c
#ifndef MODALITY_ZEPHYR_INCLUDE_MODALITY_TRACING_H_
#define MODALITY_ZEPHYR_INCLUDE_MODALITY_TRACING_H_

#include <kernel.h>

void modality_zephyr_k_thread_create(k_tid_t new_thread);
void modality_zephyr_k_thread_sleep(k_timeout_t timeout);
void modality_zephyr_k_thread_start(k_tid_t thread);
void modality_zephyr_k_thread_switched_in();
void modality_zephyr_k_fifo_get(struct k_fifo *fifo);
void modality_zephyr_k_fifo_put(struct k_fifo *fifo);

#endif
```

## src/modality_comms.c
```c
#include <assert.h>
#include <errno.h>
#include <modality/probe.h>
#include <net/socket.h>
#include <stdio.h>
#include <zephyr.h>

#include "modality_comms.h"

/** How many probes can the registry hold? */
#define MODALITY_PROBE_REGISTRY_SIZE 4

/** What is the IP address of the machine that modality is running the
    collector on?*/
#define MODALITY_COLLECTOR_IP "192.0.2.2"

/** What port is the collector running on? This is configured in
    Modality.toml, in the 'collector_connections' key.*/
#define MODALITY_COLLECTOR_PORT 34333

/** How often should we try to send reports back to modality? If
    you're getting 'dropped events' messages, try reducing this
    value. */
#define MODALITY_REPORT_CADENCE K_MSEC(1000)

/** What port should we listen on for UDP control messages? This
    should match an entry in Modality.toml's 'control_connections'
    key. */
#define MODALITY_CONTROL_PLANE_PORT 34355

/** We need to run a thread for the control plane server. How big
    should its stack be? */
#define MODALITY_CONTROL_PLANE_STACK_SIZE 2048

/** What is the priority of the control plane server thread?*/
#define MODALITY_CONTROL_PLANE_PRIORITY -1

/** The size of the buffer used to recieve and move around control messages. */
#define MODALITY_CONTROL_MESSAGE_SIZE 124 // == 128 - 4

/** The maximum number of control messages that can be in-flight at once (inside
 * the zephyr application). */
#define MODALITY_CONTROL_MESSAGE_IN_FLIGHT_COUNT 4

static int g_collector_socket = -1;
static uint8_t g_report_buffer[1400];

static uint8_t g_announce_buffer[1400];
K_MUTEX_DEFINE(g_announce_buffer_mutex);

static void modality_control_plane_run(void);
K_THREAD_DEFINE(modality_control_plane_thread_id,
                MODALITY_CONTROL_PLANE_STACK_SIZE, modality_control_plane_run,
                NULL, NULL, NULL, MODALITY_CONTROL_PLANE_PRIORITY, 0, -1);

typedef struct probe_registry_entry {
  modality_probe *probe;
  struct k_msgq *control_msgq;
  bool sent_mutator_announcment;
} probe_registry_entry;

typedef struct probe_registry {
  probe_registry_entry entries[MODALITY_PROBE_REGISTRY_SIZE];
  uint8_t count;
} probe_registry;

static probe_registry g_probe_registry = {{{0}}};
K_MUTEX_DEFINE(g_probe_registry_mutex);

static void send_modality_reports(struct k_work *work);
K_WORK_DELAYABLE_DEFINE(send_modality_reports_delayable, send_modality_reports);

typedef struct control_message {
  size_t __reserved;
  atomic_t refcount;
  uint8_t data[MODALITY_CONTROL_MESSAGE_SIZE];
} control_message;

K_HEAP_DEFINE(control_message_heap,
              sizeof(control_message) *
                  MODALITY_CONTROL_MESSAGE_IN_FLIGHT_COUNT);

int8_t register_probe(modality_probe *probe, struct k_msgq *control_msgq) {
  int8_t err = PROBE_REGISTRY_OK;
  k_mutex_lock(&g_probe_registry_mutex, K_FOREVER);

  if (g_probe_registry.count >= MODALITY_PROBE_REGISTRY_SIZE) {
    err = PROBE_REGISTRY_FULL;
  } else {
    g_probe_registry.entries[g_probe_registry.count].probe = probe;
    g_probe_registry.entries[g_probe_registry.count].control_msgq =
        control_msgq;
    g_probe_registry.entries[g_probe_registry.count].sent_mutator_announcment =
        false;

    k_thread_custom_data_set(&g_probe_registry.entries[g_probe_registry.count]);
    g_probe_registry.count++;
  }

  k_mutex_unlock(&g_probe_registry_mutex);
  return err;
}

modality_probe *current_thread_probe() {
  probe_registry_entry *current_entry = k_thread_custom_data_get();
  if (current_entry != NULL) {
    return current_entry->probe;
  } else {
    return NULL;
  }
}

void send_modality_reports(struct k_work *work) {
  modality_probe *registered_probes[MODALITY_PROBE_REGISTRY_SIZE];
  size_t registered_probe_count = 0;

  // Copy out the needed data, to keep the lock narrow
  {
    k_mutex_lock(&g_probe_registry_mutex, K_FOREVER);

    registered_probe_count = g_probe_registry.count;
    for (int i = 0; i < registered_probe_count; i++) {
      registered_probes[i] = g_probe_registry.entries[i].probe;
    }

    k_mutex_unlock(&g_probe_registry_mutex);
  }

  for (int i = 0; i < registered_probe_count; i++) {
    modality_probe *probe = registered_probes[i];

    size_t report_size;

    int key = irq_lock();
    int err = modality_probe_report(probe, g_report_buffer,
                                    sizeof(g_report_buffer), &report_size);
    irq_unlock(key);

    assert(err == MODALITY_PROBE_ERROR_OK);

    if (report_size != 0) {
      const size_t status =
          send(g_collector_socket, &g_report_buffer[0], report_size, 0);
      assert(status != -1);
    }
  }

  k_work_reschedule(&send_modality_reports_delayable, MODALITY_REPORT_CADENCE);
}

int start_modality_comms(void) {
  printf("Starting modality comms tasks...\n");

  g_collector_socket = socket(AF_INET, SOCK_DGRAM, IPPROTO_UDP);
  if (g_collector_socket < 0) {
    printf("error: socket: %d\n", errno);
    return -errno;
  }

  struct sockaddr_in modalityd_addr = {
      .sin_family = AF_INET,
      .sin_port = htons(MODALITY_COLLECTOR_PORT),
  };
  inet_pton(AF_INET, MODALITY_COLLECTOR_IP, &modalityd_addr.sin_addr);

  int ret =
      connect(g_collector_socket, (const struct sockadddr *)&modalityd_addr,
              sizeof(modalityd_addr));
  if (ret < 0) {
    printf("error: connect: %d\n", errno);
    return -errno;
  }

  k_work_reschedule(&send_modality_reports_delayable, K_MSEC(0));
  k_thread_start(modality_control_plane_thread_id);

  return 0;
}

/// Allocate a new control message with a refcount of 1
control_message *control_message_new() {
  control_message *msg = NULL;
  while (msg == NULL) {
    msg = (control_message *)k_heap_aligned_alloc(
        &control_message_heap, sizeof(void *), sizeof(control_message),
        K_FOREVER);

    // The timeout parameter to k_heap_alloc is a lie in some
    // configurations. do a sleep-retry loop.
    if (msg == NULL) {
      k_sleep(K_MSEC(50));
    }
  }

  msg->refcount = ATOMIC_INIT(0);
  return msg;
}

void control_message_ref(control_message *msg) {
  if (msg == NULL) {
    return;
  }

  atomic_val_t _prev = atomic_inc(&msg->refcount);
}

void control_message_unref(control_message *msg) {
  if (msg == NULL) {
    return;
  }
  atomic_val_t prev = atomic_dec(&msg->refcount);

  /// If we just went from 1 -> 0
  if (prev == 1) {
    k_heap_free(&control_message_heap, msg);
  }
}

static void modality_control_plane_run() {
  struct sockaddr_in addr = {.sin_family = AF_INET,
                             .sin_port = htons(MODALITY_CONTROL_PLANE_PORT),
                             .sin_addr = {.s_addr = htonl(INADDR_ANY)}};

  int server_socket = socket(AF_INET, SOCK_DGRAM, IPPROTO_UDP);
  if (server_socket < 0) {
    printf("error: socket: %d\n", errno);
  }

  if (bind(server_socket, (struct sockaddr *)&addr, sizeof(addr)) < 0) {
    printf("error: bind: %d\n", errno);
    return;
  }

  if (listen(server_socket, 5) < 0) {
    printf("error: listen: %d\n", errno);
    return;
  }

  do {
    struct sockaddr client_addr;
    socklen_t client_addr_len = sizeof(client_addr);

    control_message *msg = control_message_new();
    control_message_ref(msg);
    int received =
        recvfrom(server_socket, msg->data, MODALITY_CONTROL_MESSAGE_SIZE, 0,
                 &client_addr, &client_addr_len);

    if (received < 0) {
      /* Socket error */
      printf("error: recvfrom: %d\n", errno);
      return;
    }

    {
      k_mutex_lock(&g_probe_registry_mutex, K_FOREVER);

      int registered_probe_count = g_probe_registry.count;
      for (int i = 0; i < registered_probe_count; i++) {
        struct k_msgqw *control_msgq = g_probe_registry.entries[i].control_msgq;
        if (control_msgq != NULL) {
          control_message_ref(msg);

          k_msgq_put(control_msgq, &msg, K_FOREVER);
        }
      }

      k_mutex_unlock(&g_probe_registry_mutex);
    }

    control_message_unref(msg);

  } while (true);
}

void send_mutator_announcement(modality_probe *probe) {
  size_t announce_size;
  int err;
  size_t send_status;

  k_mutex_lock(&g_announce_buffer_mutex, K_FOREVER);

  err = modality_probe_announce_mutators(
      probe, g_announce_buffer, sizeof(g_announce_buffer), &announce_size);

  if (announce_size != 0 && err == MODALITY_PROBE_ERROR_OK) {
    send_status =
        send(g_collector_socket, &g_announce_buffer[0], announce_size, 0);
  }

  k_mutex_unlock(&g_announce_buffer_mutex);

  assert(err == MODALITY_PROBE_ERROR_OK);
  assert(send_status != -1);
}

void poll_control_plane_messages() {
  probe_registry_entry *entry =
      (probe_registry_entry *)k_thread_custom_data_get();
  if (entry == NULL) {
    return;
  }

  if (!entry->sent_mutator_announcment) {
    send_mutator_announcement(entry->probe);
    entry->sent_mutator_announcment = true;
  }

  if (entry->control_msgq != NULL) {
    while (true) {
      control_message *msg = NULL;
      int ret = k_msgq_get(entry->control_msgq, &msg, K_NO_WAIT);
      if (ret == -ENOMSG || msg == NULL) {
        break;
      }
      size_t _should_forward;
      size_t err = modality_probe_process_control_message(
          entry->probe, msg->data, MODALITY_CONTROL_MESSAGE_SIZE,
          &_should_forward);
      control_message_unref(msg);

      assert(err == MODALITY_PROBE_ERROR_OK);
    }
  }
}
```

## src/modality_comms.h
```c
#pragma once
#include <kernel.h>
#include <modality/probe.h>

int start_modality_comms(void);
void stop_modality_comms(void);

#define PROBE_REGISTRY_OK 0
#define PROBE_REGISTRY_FULL -1
int8_t register_probe(modality_probe *probe, struct k_fifo *control_fifo);
```

## src/modality_tracing.c
```c
#include <assert.h>
#include <modality/probe.h>
#include <zephyr.h>

#include "generated/modality_component_definitions.h"
#include "modality_comms.h"
#include "modality_tracing.h"

void modality_zephyr_k_thread_switched_in() {
#ifndef CONFIG_SMP
  static modality_probe *last_probe = NULL;

  modality_probe *current_probe = current_thread_probe();
  if (current_probe != NULL && current_probe != last_probe) {
    if (last_probe != NULL) {
      modality_probe_causal_snapshot last_probe_snapshot;
      int err;

      err = modality_probe_produce_snapshot(last_probe, &last_probe_snapshot);
      assert(err == MODALITY_PROBE_ERROR_OK);

      err = modality_probe_merge_snapshot(current_probe, &last_probe_snapshot);
      assert(err == MODALITY_PROBE_ERROR_OK);
    }

    last_probe = current_probe;
  }
#endif
}

void modality_zephyr_k_thread_create(k_tid_t new_thread) {
  modality_probe *probe = current_thread_probe();
  if (probe) {
    MODALITY_PROBE_RECORD_W_U32(probe, K_THREAD_CREATE, (uint32_t)&new_thread,
                                MODALITY_TAGS("zephyr", "syscall", "thread"));
  }
}

void modality_zephyr_k_thread_start(k_tid_t thread) {
  modality_probe *probe = current_thread_probe();
  if (probe) {
    MODALITY_PROBE_RECORD_W_U32(probe, K_THREAD_START, (uint32_t)&thread,
                                MODALITY_TAGS("zephyr", "syscall", "thread"));
  }
}

void modality_zephyr_k_thread_sleep(k_timeout_t timeout) {
  modality_probe *probe = current_thread_probe();
  if (probe) {
    MODALITY_PROBE_RECORD_W_U32(probe, K_THREAD_SLEEP, (uint32_t)timeout.ticks,
                                MODALITY_TAGS("zephyr", "syscall", "thread"));
  }
}

void modality_zephyr_k_fifo_get(struct k_fifo *fifo) {
  modality_probe *probe = current_thread_probe();
  if (probe) {
    MODALITY_PROBE_RECORD_W_U32(probe, K_FIFO_GET, (uint32_t)fifo,
                                MODALITY_TAGS("zephyr", "syscall", "fifo"));
  }
}

void modality_zephyr_k_fifo_put(struct k_fifo *fifo) {
  modality_probe *probe = current_thread_probe();
  if (probe) {
    MODALITY_PROBE_RECORD_W_U32(probe, K_FIFO_PUT, (uint32_t)fifo,
                                MODALITY_TAGS("zephyr", "syscall", "fifo"));
  }
}
```
