## CMakeLists.txt
```
cmake_minimum_required(VERSION 3.13.1)

list(APPEND ZEPHYR_EXTRA_MODULES ${CMAKE_CURRENT_SOURCE_DIR}/../../)

set(
    MODALITY_PROBE_ROOT
    "/usr/local/modality"
    CACHE
    PATH
    "Modality tar package installation directory")
set(
    MODALITY_PROBE_TARGET_TRIPLE
    "thumbv7m-none-eabi"
    CACHE
    STRING
    "Target triple")

list(APPEND CMAKE_MODULE_PATH "${MODALITY_PROBE_ROOT}/cmake")

find_package(Zephyr REQUIRED HINTS $ENV{ZEPHYR_BASE})

# We're adding user-level events and will be using Modality helper functions
find_package(ModalityProbe REQUIRED)

project(modality-example LANGUAGES C)
target_sources(app PRIVATE src/main.c)
target_include_directories(app PRIVATE ${CMAKE_CURRENT_SOURCE_DIR})

# Generate user-level event instrumentation, combined with the provided tracing events
modality_probe_generate_manifest(
    TARGET app
    DEPENDS src/main.c
    COMPONENT_NAME "modality-component"
    OUTPUT_PATH "modality-component"
    EXCLUDES "build"
    FILE_EXTENSIONS "c"
    # Tracing events reserve the range 1..=0xFFFF, user events start after
    EVENT_ID_OFFSET 65536
    SOURCE_PATH src/main.c)

# Generate C definitions for the events
modality_probe_generate_header(
    TARGET app
    OUTPUT_FILE "generated_component_definitions.h"
    COMPONENT_PATH "modality-component")
```

## west.yml
```
manifest:
  self:
    path: modality-example

  remotes:
    - name: zephyrproject-rtos
      url-base: https://github.com/auxoncorp

  projects:
    - name: zephyr
      remote: zephyrproject-rtos
      revision: add-external-tracing-support-v2.6.0
      import: true
```

## prj.conf
```kconfig
CONFIG_THREAD_NAME=y
CONFIG_THREAD_CUSTOM_DATA=y
CONFIG_LOG=y
CONFIG_HEAP_MEM_POOL_SIZE=8192

CONFIG_TRACING=y
CONFIG_TRACING_EXTERNAL=y
CONFIG_MODALITY_PROBE_TRACING=y
CONFIG_MODALITY_PROBE_USE_STATIC_ALLOCATION=n
CONFIG_MODALITY_PROBE_MAX_PROBES=2
CONFIG_MODALITY_PROBE_EXCLUDE_MAIN_THREAD=y
CONFIG_MODALITY_PROBE_THREAD_PROBE_SIZE=1024
CONFIG_MODALITY_PROBE_USE_CONTROL_PLANE_MESSAGE_QUEUE=y

CONFIG_MAIN_STACK_SIZE=4096
CONFIG_LOG_PROCESS_THREAD_STACK_SIZE=2048
CONFIG_TRACING_THREAD_STACK_SIZE=4096

CONFIG_TEST_RANDOM_GENERATOR=y
CONFIG_ETH_STELLARIS=y
CONFIG_NET_L2_ETHERNET=y
CONFIG_NET_QEMU_ETHERNET=y

CONFIG_NET_CONFIG_SETTINGS=y
CONFIG_NET_CONFIG_NEED_IPV4=y
CONFIG_NET_CONFIG_MY_IPV4_ADDR="192.0.2.1"
CONFIG_NET_CONFIG_PEER_IPV4_ADDR="192.0.2.2"

CONFIG_STACK_CANARIES=y

CONFIG_MAIN_THREAD_PRIORITY=-1
```

## src/main.c
```c
#include <zephyr.h>
#include <inttypes.h>
#include <assert.h>

/* Generated application event definitions */
#include "generated_component_definitions.h"

#define STACK_SIZE (2048)
#define PRODUCER_PRI -1
#define CONSUMER_PRI -1

static void producer_run(void);
K_THREAD_DEFINE(
        producer_thread,
        STACK_SIZE,
        producer_run,
        NULL, NULL, NULL,
        PRODUCER_PRI, 0, -1);

static void consumer_run(void);
K_THREAD_DEFINE(
        consumer_thread,
        STACK_SIZE,
        consumer_run,
        NULL, NULL, NULL,
        CONSUMER_PRI, 0, -1);

K_MSGQ_DEFINE(message_q, sizeof(uint32_t), 10, 4);

void main(void)
{
    printk("Modality Zephyr Example\n");

    k_thread_start(producer_thread);
    k_thread_start(consumer_thread);

    while(1)
    {
        k_msleep(1000);
        printk("Main loop\n");
    }
}

static void producer_run(void)
{
    int err;
    uint32_t val = 0;
    printk("Producer started\n");

    // This thread opts in to handling control plane messages for mutations/etc
    trace_alloc_control_plane_message_queue();

    modality_probe* probe = trace_get_thread_probe();
    assert(probe != NULL);

    while(1)
    {
        trace_process_control_plane_message();

        printk("Producing %" PRIu32 "\n", val);

        err = MODALITY_PROBE_RECORD_W_U32(
                    probe,
                    PRODUCING,
                    val,
                    MODALITY_TAGS("app", "ipc"),
                    "Producing message");
        assert(err == MODALITY_PROBE_ERROR_OK)

        err = k_msgq_put(&message_q, &val, K_FOREVER);
        assert(err == 0);
        val += 1;

        k_msleep(500);
    }
}

static void consumer_run(void)
{
    int err;
    uint32_t val;
    printk("Consumer started\n");

    modality_probe* probe = trace_get_thread_probe();
    assert(probe != NULL);

    while(1)
    {
        err = k_msgq_get(&message_q, &val, K_FOREVER);
        assert(err == 0);

        printk("Consuming %" PRIu32 "\n", val);

        err = MODALITY_PROBE_EXPECT(
                probe,
                RX_MSG,
                (val % 2 == 0),
                MODALITY_SEVERITY(10),
                MODALITY_TAGS("app", "ipc"),
                "Received message");
        assert(err == MODALITY_PROBE_ERROR_OK);
    }
}
```
